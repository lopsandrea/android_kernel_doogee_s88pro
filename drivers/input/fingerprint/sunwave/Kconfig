## drivers/power/supply/mediatek/charger/Kconfig
```kconfig
config MTK_CHARGER
	bool "MediaTek Charging Driver"
	depends on MEDIATEK_SOLUTION
	default n
	help
	  Say yes here to enable MediaTek charging driver.
	  This driver contains charging control flow and
	  maintains charging status.
	  Say no if not using MediaTek charging driver.

config POWER_EXT
	bool "MediaTek Power Ext"
	default n
	help
	  Check this if the device is not powered by battery.
	  For example, if the device is powered by AC adapter.
	  Select No if the device needs info about
	  battery voltage, temperature, etc.

config MTK_SWCHR_SUPPORT
	bool "MediaTek switch charger"
	default n
	depends on MTK_CHARGER
	help
	  This is to enable switching charger control flow.
	  switching charger has better performance than pulse charger
	  Set to yes if switching charger is used.
	  Set to no if pmic pulse charger is used.

config MTK_KERNEL_POWER_OFF_CHARGING
	bool "MTK kernel power off charging"
	default n
	depends on MTK_CHARGER
	help
	  yes : support KPOC feature, power off charging would running by
	  kernel and charging animation by kpoc service. no: not support KPOC
	  feature.
	  device won't enter charging mode if config is no.

config MTK_PUMP_EXPRESS_PLUS_SUPPORT
	bool "MediaTek PUMP EXPRESS PLUS"
	default n
	depends on MTK_CHARGER
	help
	  Fast charging technology using switch charger and current pattern
	  to achive better charging ability.
	  Set Yes to enable PE+
	  Set No to disable PE+

config MTK_PUMP_EXPRESS_PLUS_20_SUPPORT
	bool "MediaTek PUMP EXPRESS PLUS 2.0"
	default n
	depends on MTK_CHARGER
	help
	  Fast charging technology using switch charger and current pattern
	  to achive better charging ability. It has higher charging efficiency
	  and has better thermal performance than PE+.
	  Set Yes to enable PE+2.0
	  Set No to disable PE+2.0

config MTK_DUAL_CHARGER_SUPPORT
	bool "MediaTek dual charger support"
	default n
	depends on MTK_CHARGER
	help
	  Use two charging ICs (master and slave) to charge the system.
	  The master IC is connected to VBUS, VSYS, and VBAT, the slave
	  IC is conneceted to PMID pin from the master and VBAT.
	  Say Yes to enable dual charger support.

config SWCHR_POWER_PATH
	bool "External charger IC supports powerpath"
	default n
	depends on MTK_CHARGER
	help
	  Set Yes if the external charger IC
	  supports power path function.
	  This affects setting of auxadc channels
	  used to representing voltage of system
	  or battery.

config MTK_BQ24196_SUPPORT
	bool "MediaTek Battery driver for TI BQ24196 charger IC"
	help
	  BQ24196 charger IC support
	  This is to enable MediaTek supports to BQ24196.
	  It depends on config MTK_SMART_BATTERY
	  and config MTK_SWCHR_SUPPORT
	  Set to Yes if BQ24196 is used.

config MTK_BQ24296_SUPPORT
	bool "MediaTek Battery driver for TI BQ24296 charger IC"
	help
	  This is to enable MediaTek supports to BQ24296 Charger IC.
	  It depends on config MTK_SMART_BATTERY
	  and config MTK_SWCHR_SUPPORT
	  Set to Yes if BQ24296 is used.

config CHARGER_RT9465
	bool "Charger Driver for Richtek RT9465 Charger IC"
	default n
	depends on MTK_CHARGER
	help
	  Say Yes to enable Richtek RT9465 driver.
	  It is mainly used as slave IC for dual charger
	  application.
	  It depends on config MTK_CHARGER.

config CHARGER_RT9458
	bool "Charger Driver for Richtek RT9458 Charger IC"
	default n
	depends on MTK_SWCHR_SUPPORT
	help
	  Say Y to enable
	  Richtek RT9458 driver.
	  It depends on
	  the config MTK_SWCHR_SUPPORT.

config CHARGER_RT9467
	bool "Charger Driver for Richtek RT9467 Charger IC"
	default n
	depends on MTK_CHARGER
	help
	  Say Yes to enable Richtek RT9467 driver.
	  It is mainly used as slave IC for dual charger
	  application.
	  It depends on config MTK_CHARGER.

config CHARGER_RT9471
	bool "Charger Driver for Richtek RT9471 Charger IC"
	default n
	depends on MTK_CHARGER
	help
	  Say Yes to enable Richtek RT9471 driver.
	  It supports RT9470/RT9470D/RT9471/RT9471D,
	  which RT9470D and RT9471D support BC1.2
	  It depends on config MTK_CHARGER.

config MTK_CHARGER_UNLIMITED
	bool "MediaTek Charger Unlimited"
	default n
	depends on MTK_CHARGER
	help
	  Say Yes to release charging current restrictions.
	  Say No to not release charging current restrictions.
	  It is mainly used for long-term tests.
	  It depends on config MTK_CHARGER.

config CHARGER_HL7005
	bool "Charger Driver for Halo HL7005 Charger IC"
	depends on MTK_SWCHR_SUPPORT
	help
	  Say Y to enable
	  Halo HL7005 driver.
	  It depends on config MTK_SWCHR_SUPPORT.

#
# LE OPZIONI DI FABBRICA CHE MANCAVANO, dichiarate il 2026-08-26.
#
# Il .config di fabbrica le ha tutte a =y e il nostro albero non le
# dichiarava affatto: `olddefconfig` scarta un simbolo che nessun Kconfig
# definisce, quindi non c'era modo di accenderle.
#
# ATTENZIONE, e va detto prima di leggerle come «funzioni aggiunte»:
# **nessuna di queste guardia protegge codice che esista in questo albero.**
# Accenderle allinea il .config al kernel di fabbrica e non cambia un byte
# del binario. Servono a due cose:
#
#   1. togliere quindici differenze dal confronto dei config, che e' una
#      delle tre misure del progetto;
#   2. dare un posto dove attaccare il codice quando lo si scrivera'.
#
# Il posto in cui stanno lo abbiamo scelto noi, per sottosistema: il Kconfig
# di fabbrica non e' fra i file recuperati, e dedurlo dal binario non si puo'
# -- un simbolo di Kconfig non lascia traccia nel codice compilato.
#

config MTK_SGM2541_IC_OTG
	bool "OTG sul SGM2541 (nome di fabbrica)"
	default y

config MTK_WLS_SUPPORT
	bool "carica senza fili (nome di fabbrica)"
	default y
	help
	  Il driver del ricevitore, MT5725, c'e' e misura 44 funzioni su 50
	  uguali alla fabbrica -- ma non nomina questa guardia da nessuna parte.

config MTK_REVERSER_CHARGER_SUPPORT
	bool "carica inversa (nome di fabbrica)"
	default y

config MT5725_REVERSER_CHARGER
	bool "carica inversa sul MT5725 (nome di fabbrica)"
	default y
	help
	  Sta qui e non in mt5725/Kconfig perche' quel file e' portato da
	  mt5725-dal-disassemblato.patch: metterci dentro una voce di config
	  farebbe litigare due patch che parlano di cose diverse. Il posto
	  giusto secondo la fabbrica non lo sappiamo -- il suo Kconfig non e'
	  fra i file recuperati.

config CHARGER_BQ25601
	bool "CHARGER_BQ25601"
	help
	  This is to enable MediaTek supports to BQ25601.
	  It depends on config MTK_SMART_BATTERY
	  and config MTK_SWCHR_SUPPORT
	  Set to Yes if BQ25601 is used.
source "drivers/power/supply/mediatek/charger/mt5725/Kconfig"
source "drivers/power/supply/mediatek/charger/usb_insert_detect/Kconfig"
```

## drivers/power/supply/mediatek/charger/mt5725/Kconfig
```kconfig
config MTK_MT5725_WLS_SUPPORT
	bool "Maxic MT5725 wireless charger (Doogee S88 Pro, from the disassembly)"
	depends on MTK_CHARGER
	select WTK_USB_INSERT_DETECT
	default n
	help
	  Maxic MT5725 wireless charger of the Doogee S88 Pro (E977),
	  reconstructed by reading the disassembled factory kernel. The factory
	  config turns it on (CONFIG_MTK_MT5725_WLS_SUPPORT=y) and no public tree
	  has the source: without this symbol `olddefconfig` silently discards the
	  factory config line and the driver never enters the kernel.

	  THE `select` IS NOT A CONVENIENCE.  `mt5725.c` calls `usb_insert_online`,
	  which lives in another translation unit of which this project has
	  reconstructed ONE function out of five: without it the kernel link stops
	  with "undefined reference to `usb_insert_online'".  Measured -- it is the
	  fifth of the six symbols the first `LD vmlinux` ever attempted asked for.
```

## drivers/power/supply/mediatek/charger/usb_insert_detect/Kconfig
```kconfig
config WTK_USB_INSERT_DETECT
	bool "Wingtech USB insertion detection (Doogee S88 Pro, PARTIAL BATCH)"
	default n
	help
	  ONE function out of five, and that has to be said at the top.

	  The factory translation unit has five of them, in a contiguous run right
	  after the end of `mt5725`:

	    ffffff8008ace8f0 T usb_insert_online                 <- THIS ONE, 20 bytes
	    ffffff8008ace904 t usb_insert_detect_probe           (596 bytes)
	    ffffff8008aceb58 t usb_insert_detect_remove          (8 bytes)
	    ffffff8008aceb60 t usb_insert_detect_thread_kthread
	    ffffff8009385a80 t usb_insert_detect_init            (in .init.text)

	  THERE IS ONLY ONE HERE, and the reason is explicit: `mt5725` calls it,
	  and without it that driver -- complete in every other respect -- does not
	  link.  The other four were not written, and they are not postponed out of
	  difficulty: they simply were not needed to close the mt5725 link.

	  THE DRIVER DOES NOT WORK LIKE THIS: with no `probe` nobody registers
	  anything and `usb_insert_online` reads an `int` nobody updates, so it
	  always returns the same value.  It is DECLARED SCAFFOLDING for the link,
	  not a driver, and it is `select`ed by MTK_MT5725_WLS_SUPPORT exactly for
	  that -- turning it on by itself makes no sense.
```
