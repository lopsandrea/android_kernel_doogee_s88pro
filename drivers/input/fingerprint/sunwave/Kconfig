## drivers/misc/mediatek/flashlight/Kconfig
```kconfig
#
# Flashlight device configuration
#

config MTK_FLASHLIGHT
	tristate "Mediatek flashlight driver"
	default n
	help
	  This is flashlight driver for camera.

	  Say Y here if you want a flashlight core to handle flashlight devices.
	  If you have any questions about this, say Y here, only say N
	  if you know exactly what you are doing.

config MTK_FLASHLIGHT_LED191
	tristate "Mediatek flashlight led191 gpio driver"
	depends on MTK_FLASHLIGHT
	default n
	help
	  This is flashlight led191 gpio driver for camera.

	  Say Y here if you want a driver IC with GPIO interface.
	  Select this only if your board has this IC.

	  Say M here if you want to compile this driver as a module.

config MTK_FLASHLIGHT_LM3642
	tristate "Mediatek flashlight with driver IC (TI LM3642)"
	depends on MTK_FLASHLIGHT
	default n
	help
	  This is for the flashlight driver IC (TI LM3642).

	  Say Y here if you want a flashlight driver IC LM3642.
	  Select this only if your board has this IC.

	  Say M here if you want to compile this driver as a module.

config MTK_FLASHLIGHT_LM3643
	tristate "Mediatek flashlight with driver IC (TI LM3643)"
	depends on MTK_FLASHLIGHT
	default n
	help
	  This is for the flashlight driver IC (TI LM3643).

	  Say Y here if you want a flashlight driver IC LM3643.
	  Select this only if your board has this IC.

	  Say M here if you want to compile this driver as a module.

config MTK_FLASHLIGHT_LM3644
	tristate "Mediatek flashlight with driver IC (TI LM3644)"
	depends on MTK_FLASHLIGHT
	default n
	help
	  This is for the flashlight driver IC (TI LM3644).

	  Say Y here if you want a flashlight driver IC LM3644.
	  Select this only if your board has this IC.

	  Say M here if you want to compile this driver as a module.

config MTK_FLASHLIGHT_RT4505
	tristate "Mediatek flashlight with driver IC (Richtek RT4505)"
	depends on MTK_FLASHLIGHT
	default n
	help
	  This is for the flashlight driver IC (Richtek RT4505).

	  Say Y here if you want a flashlight driver IC RT4505.
	  Select this only if your board has this IC.

	  Say M here if you want to compile this driver as a module.

config MTK_FLASHLIGHT_RT5081
	tristate "Mediatek flashlight with driver IC (Richtek RT5081)"
	depends on MTK_FLASHLIGHT && RT_FLASHLIGHT
	default n
	help
	  This is for the flashlight driver IC (Richtek RT5081).

	  Say Y here if you want a flashlight driver IC RT5081.
	  Select this only if your board has this IC.

	  Say M here if you want to compile this driver as a module.

config MTK_FLASHLIGHT_MT6336
	tristate "Mediatek flashlight with driver IC (Mediatek MT6336)"
	depends on MTK_FLASHLIGHT
	default n
	help
	  This is for the flashlight driver IC (Mediatek MT6336).

	  Say Y here if you want a flashlight driver IC MT6336.
	  Select this only if your board has this IC.

	  Say M here if you want to compile this driver as a module.

config MTK_FLASHLIGHT_MT6370
	tristate "Mediatek flashlight with driver IC (Mediatek MT6370)"
	depends on MTK_FLASHLIGHT && RT_FLASHLIGHT
	default n
	help
	  This is for the flashlight driver IC (Mediatek MT6370).

	  Say Y here if you want a flashlight driver IC MT6370.
	  Select this only if your board has this IC.

	  Say M here if you want to compile this driver as a module.

config MTK_FLASHLIGHT_MT6360
	tristate "Mediatek flashlight with driver IC (Mediatek MT6360)"
	depends on MTK_FLASHLIGHT && RT_FLASHLIGHT
	default n
	help
	  This is for the flashlight driver IC (Mediatek MT6360).

	  Say Y here if you want a flashlight driver IC MT6360.
	  Select this only if your board has this IC.

	  Say M here if you want to compile this driver as a module.

config MTK_FLASHLIGHT_DUMMY
	tristate "Mediatek flashlight dummy driver"
	depends on MTK_FLASHLIGHT
	default n
	help
	  This is flashlight dummy driver for camera.

	  Say Y here if you want a dummy driver IC with I2C interface.
	  Select this only if your board has this IC.

	  Say M here if you want to compile this driver as a module.

config MTK_FLASHLIGHT_DUMMY_GPIO
	tristate "Mediatek flashlight dummy gpio driver"
	depends on MTK_FLASHLIGHT
	default n
	help
	  This is flashlight dummy gpio driver for camera.

	  Say Y here if you want a dummy driver IC with GPIO interface.
	  Select this only if your board has this IC.

	  Say M here if you want to compile this driver as a module.

config MTK_FLASHLIGHT_DEBUG
	bool "Mediatek flashlight debugging messages"
	depends on MTK_FLASHLIGHT
	default n
	help
	  Say Y here if you want the flashlight to produce a bunch of debug
	  messages to the system log.

	  Select this if you are having a problem with flashlight support
	  and want to see more of what is going on.

config MTK_FLASHLIGHT_PT
	bool "Mediatek flashlight power throttling"
	depends on MTK_FLASHLIGHT
	default n
	help
	  This is for flashlight power throttling.

	  Power throttling will limit flashlight function,
	  such as disable flashlight, decrease brightness level or
	  change flash mode to torch mode.

config MTK_FLASHLIGHT_PT_STRICT
    bool "Mediatek flashlight power throttling (strict)"
	depends on MTK_FLASHLIGHT_PT
	default n
	help
	  This is for flashlight strict power throttling.

	  Strict power throttling will disable flashlight when
	  over-current, low battary voltage and low battary percentage
	  situations.

config MTK_FLASHLIGHT_DLPT
    bool "Mediatek flashlight dynamic low power throttling"
	depends on MTK_FLASHLIGHT
	default n
	help
	  This is for flashlight dynamic low power throttling.

	  Dynamic low power throttling is a mechanism to monitor
	  the current of battary dynamicly. It will start by request
	  and notice user by kernel notifier.

#
# THE FACTORY OPTIONS THAT WERE MISSING, declared on 2026-08-26.
#
# The factory .config has them all at =y and our tree did not declare them
# at all: `olddefconfig` discards a symbol no Kconfig defines, so there was
# no way to turn them on.
#
# BEWARE, and this has to be said before reading them as "added features":
# **none of these guards protects code that exists in this tree.**
# Turning them on aligns the .config with the factory kernel and does not change
# a byte of the binary. They serve two purposes:
#
#   1. removing fifteen differences from the config comparison, which is one
#      of the three measurements of the project;
#   2. giving the code somewhere to attach to when it gets written.
#
# Where they sit is our own choice, by subsystem: the factory Kconfig is not
# among the recovered files, and deriving it from the binary is impossible
# -- a Kconfig symbol leaves no trace in compiled code.
#

config WTK_MAIN_FLASHLIGHT_CH0
	bool "main flash channel 0 (factory name)"
	default y
	help
	  The factory .config has CONFIG_WTK_MAIN_FLASHLIGHT_CH0=y.

	  In this tree the name appears in four files -- flashlight-device.c,
	  flashlights-mt6370.c and mt6370_pmu_charger.c -- but ONLY IN COMMENTS:
	  no #ifdef tests it. The flashlight block measures 90 functions out of
	  90 equal to the factory ones all the same, so nothing has been missing
	  so far, and turning this entry on does not change the generated code.
```

## drivers/misc/mediatek/leds/Kconfig
```kconfig
config MTK_LEDS
	tristate "MediaTek LED Support"
	depends on LEDS_CLASS
	---help---
	  This selects the MediaTek(R) LEDs connected to MediaTek chips.
	  If you want to use MediaTek(R) LEDs support, say Y or M here.
	  If unsure, say N.
	  Mediatek LED module includes backlight, indicate LED, keypad LED, button LED etc.

config LIGHTNESS_MAPPING_VALUE
	int "Backlight brightness mapping value"
	default 255
	---help---
	  Backlight brightness mapping value, from 0 to 255.

config BACKLIGHT_SUPPORT_LP8557
	bool "Support backlight lp8557 board"
	default n
	---help---
	  LED driver for LP8557 support.
	  Set y to support.
	  Set n to disable.
	  For pwm external backlight.

config BACKLIGHT_SUPPORT_LM3697
	bool "LM3697(DW8832) Support"
	default n
	---help---
	  LED driver for lm3697(dw8832) support.
	  Set y to support.
	  Set n to disable.
	  Charge pump driver for external backlight.

config WTK_LEDS_AW22127
	bool "Awinic AW22xxx case LEDs (Doogee S88 Pro, from the disassembly)"
	depends on I2C && LEDS_CLASS
	help
	  Awinic AW22xxx case LEDs, reconstructed by reading the factory kernel
	  of the Doogee S88 Pro. The factory config turns them on
	  (CONFIG_WTK_LEDS_AW22127=y); no public tree has the source.
	  See docs/bringup/driver-riscritti.md.
```

## drivers/misc/mediatek/sensors-1.0/accelerometer/da218-B/Kconfig
```kconfig
config WTK_DA218B
	bool "MiraMEMS DA218-B (mir3da) for MediaTek package (Doogee S88 Pro, from the disassembly)"
	default n
	help
	  MiraMEMS DA218-B accelerometer ("mir3da" in the factory symbols) of the
	  Doogee S88 Pro, reconstructed by reading the disassembled factory
	  kernel.  The factory config turns it on (CONFIG_WTK_DA218B=y, line 1557
	  of e977_dg_m13_71_q0.config); no public tree has the source -- neither
	  ALPS nor the .186 branch.

	  Two translation units: mir3da_cust.c (37 functions out of 37) and
	  mir3da_core.c (19 of the core block's 29 functions).  The 19 are the
	  transitive closure of what the link needs: the 9 boundary ones declared
	  in mir3da_core.h, the 6 those call (mir3da_read_raw_data,
	  mir3da_temp_calibrate, mir3da_read_offset, mir3da_parse_chip_info,
	  mir3da_module_detect, squareRoot) and the 4 pointed at by the chip
	  descriptor table.  The 10 left out are globals no other kernel object
	  calls: the list, with the reason, is in the header of mir3da_core.c, §1.
```

## drivers/misc/mediatek/sensors-1.0/alsps/ltr2568/Kconfig
```kconfig
config ODM_LTR2568
	bool "Lite-On LTR-2568 ALS/PS for MediaTek package (Doogee S88 Pro, from the disassembly)"
	default n
	help
	  Lite-On LTR-2568 ambient light and proximity sensor of the Doogee S88
	  Pro, reconstructed by reading the disassembled factory kernel. The
	  factory config turns it on (CONFIG_ODM_LTR2568=y) and no public tree has
	  the source: without this symbol `olddefconfig` discards the factory
	  config line in silence and the driver never enters the kernel. See
	  docs/bringup/driver-riscritti.md.
```

## drivers/misc/mediatek/sensors-1.0/magnetometer/qmcx983/Kconfig
```kconfig
config WTK_QMCX983
	bool "QST QMC7983 for MediaTek package (Doogee S88 Pro, from the disassembly)"
	default n
	help
	  QST QMC7983 magnetometer ("qmcX983" in the factory symbols) of the
	  Doogee S88 Pro, reconstructed by reading the disassembled factory
	  kernel. The factory config turns it on (CONFIG_WTK_QMCX983=y); no public
	  tree has the source. See docs/bringup/driver-riscritti.md.
```
