## drivers/input/touchscreen/mediatek/GT917S/Kconfig
```kconfig
config WTK_GT917S_E977
	bool "Goodix GT917S touch for the MediaTek package (Doogee S88 Pro, from the disassembly)"
	default n
	depends on !TOUCHSCREEN_MTK_GT1151 && !TOUCHSCREEN_MTK_GT5688
	help
	  Goodix GT917S touchscreen of the Doogee S88 Pro, reconstructed by
	  reading the disassembled factory kernel.  The factory config turns it
	  on (CONFIG_WTK_GT917S_E977=y at line 2220 of
	  e977_dg_m13_71_q0.config) and the ALPS tree does not have the symbol:
	  without this entry `olddefconfig` discards the factory config line in
	  silence.

	  THE `depends on` IS NOT A PRECAUTION, IT IS A MEASUREMENT.  The three
	  Goodix variants define the SAME global symbols:

	    $ comm -12 <(nm --defined-only --extern-only GT917S/built-in.o) \
	                <(nm --defined-only --extern-only GT5688/built-in.o)
	    92 names, among them gt1x_i2c_read, gt1x_init, gesture_event_handler
	    (91 with GT1151/)

	  Turning two of them on together makes the link fail with "multiple
	  definition".  The factory indeed keeps both off (lines 2210 and 2216
	  of the same config), and this line makes it impossible instead of
	  leaving it to whoever configures.

	  THERE IS NO SECOND `depends on`, and an earlier draft had a wrong one:
	  it excluded ILITEK and FT8719 "because all three register a
	  tpd_driver_t for the same panel".  The factory config turns all three
	  on (lines 2220, 2224, 2227), and MediaTek's `tpd` framework chooses at
	  run time.  The three do not even have one global symbol in common --
	  measured, zero -- so there is nothing to exclude.  The constraint that
	  remains is only the Goodix one above, which is a real collision.

	  The factory block has 85 functions in six translation units, and 84
	  match to the byte with the factory compiler (clang-r353983c).  The only
	  one that differs is gt1x_touch_event_handler, +8.

# ---------------------------------------------------------------------------
# THE `GTP_*` SYMBOLS, AND WHY THEY ARE HERE
# ---------------------------------------------------------------------------
# GT917S did not build from the config at all, and the first real link found out:
#
#   gt1x_generic.c:990:7: error: use of undeclared identifier 'gesture_enabled'
#   gt1x_generic.c:2216:6: error: use of undeclared identifier 'hotknot_enabled'
#   gt1x_generic.c:2408:19: error: use of undeclared identifier 'GTP_INT_TRIGGER'
#
# The sources use those names, and `include/gt1x_tpd_common.h` declares them only
# under CONFIG_GTP_GESTURE_WAKEUP, CONFIG_GTP_HOTKNOT and CONFIG_GTP_CUSTOM_CFG.
# Those symbols, however, lived INSIDE `if TOUCHSCREEN_MTK_GT5688` in GT5688's
# Kconfig: they exist only if GT5688 is on, and the factory keeps it off.
#
# IT IS A DEFECT OF MEASUREMENT, NOT ONLY OF WIRING. The "84 functions out of 85
# equal to the byte" for GT917S was measured in a tree whose `.config` had
# CONFIG_TOUCHSCREEN_MTK_GT5688=y -- that is, in a configuration that is NOT the
# factory one, and from which the block borrowed its GTP_*.
# The defaults below reproduce exactly the ones the measurement was made with,
# so that the number stays reproducible without GT5688:
#
#   CONFIG_GTP_CUSTOM_CFG=y      CONFIG_GTP_AUTO_UPDATE=y
#   CONFIG_GTP_GESTURE_WAKEUP=y  CONFIG_GTP_CREATE_WR_NODE=y
#   CONFIG_GTP_HOTKNOT=y         (all the others: n)
#
# Kconfig allows the same symbol to be defined in more than one file -- the entries
# merge -- and the two `if`s are mutually exclusive by construction.

if WTK_GT917S_E977
config GT917S_FIRMWARE
	string "GT917S per MediaTek firmware"

config GT917S_CONFIG
	string "GT917S per MediaTek config"

config GTP_DRIVER_SEND_CFG
	bool "GT917S per MediaTek package"
	default n
	default y
	help
	  Say Y here if you have GT5688 touch panel GTP_DRIVER_SEND_CFG.

	  If unsure, say N.

	  To compile this dirver as a module, choose M here: the
	  module will be called.

config GTP_CUSTOM_CFG
	bool "GT917S per MediaTek package"
	default y
	help
	  Say Y here if you have GT5688 touch panel GTP_CUSTOM_CFG.

	  If unsure, say N.

	  To compile this dirver as a module, choose M here: the
	  module will be called.

config GTP_CHANGE_X2Y
	bool "GT917S per MediaTek package"
	default n
	help
	  Say Y here if you have GT5688 touch panel GTP_CHANGE_X2Y.

	  If unsure, say N.

	  To compile this dirver as a module, choose M here: the
	  module will be called.

config GTP_WARP_X_ON
	bool "GT917S per MediaTek package"
	default n
	help
	  Say Y here if you have GT5688 touch panel GTP_WARP_X_ON.

	  If unsure, say N.

	  To compile this dirver as a module, choose M here: the
	  module will be called.

config GTP_WARP_Y_ON
	bool "GT917S per MediaTek package"
	default n
	help
	  Say Y here if you have GT5688 touch panel GTP_WARP_Y_ON.

	  If unsure, say N.

	  To compile this dirver as a module, choose M here: the
	  module will be called.

config GTP_GESTURE_WAKEUP
	bool "GT917S per MediaTek package"
	default y
	help
	  Say Y here if you have GT5688 touch panel GTP_GESTURE_WAKEUP.

	  If unsure, say N.

	  To compile this dirver as a module, choose M here: the
	  module will be called.

config GTP_HOTKNOT
	bool "GT917S per MediaTek package"
	default y
	help
	  Say Y here if you have GT5688 touch panel GTP_HOTKNOT.

	  If unsure, say N.

	  To compile this dirver as a module, choose M here: the
	  module will be called.

config HOTKNOT_TYPE
	bool "GT917S per MediaTek package"
	help
	  Say Y here if you have GT5688 touch panel HOTKNOT_TYPE.

	  If unsure, say N.

	  To compile this dirver as a module, choose M here: the
	  module will be called.

config HOTKNOT_BLOCK_RW
	bool "GT917S per MediaTek package"
	help
	  Say Y here if you have GT5688 touch panel HOTKNOT_BLOCK_RW.

	  If unsure, say N.

	  To compile this dirver as a module, choose M here: the
	  module will be called.

config GTP_PROXIMITY
	bool "GT917S per MediaTek package"
	default n
	help
	  Say Y here if you have GT5688 touch panel GTP_PROXIMITY.

	  If unsure, say N.

	  To compile this dirver as a module, choose M here: the
	  module will be called.

config GTP_WITH_STYLUS
	bool "GT917S per MediaTek package"
	default n
	help
	  Say Y here if you have GT5688 touch panel GTP_WITH_STYLUS.

	  If unsure, say N.

	  To compile this dirver as a module, choose M here: the
	  module will be called.

config GTP_HAVE_STYLUS_KEY
	bool "GT917S per MediaTek package"
	default n
	help
	  Say Y here if you have GT5688 touch panel GTP_HAVE_STYLUS_KEY.

	  If unsure, say N.

	  To compile this dirver as a module, choose M here: the
	  module will be called.

config GTP_AUTO_UPDATE
	bool "GT917S per MediaTek package"
	default y
	help
	  Say Y here if you have GT5688 touch panel GTP_AUTO_UPDATE.

	  If unsure, say N.

	  To compile this dirver as a module, choose M here: the
	  module will be called.

config GTP_HEADER_FW_UPDATE
	bool "GT917S per MediaTek package"
	default n
	help
	  Say Y here if you have GT5688 touch panel GTP_HEADER_FW_UPDATE.

	  If unsure, say N.

	  To compile this dirver as a module, choose M here: the
	  module will be called.

config GTP_REQUEST_FW_UPDATE
	bool "GT917S per MediaTek package"
	default n
	help
	Say Y here if you have GT5688 touch panel GTP_REQUEST_FW_UPDATE.

	If unsure, say N.

	To compile this dirver as a module, choose M here: the
	module will be called.

config GTP_CREATE_WR_NODE
	bool "GT917S per MediaTek package"
	default y
	help
	  Say Y here if you have GT5688 touch panel GTP_CREATE_WR_NODE.

	  If unsure, say N.

	  To compile this dirver as a module, choose M here: the
	  module will be called.

config GTP_ESD_PROTECT
	bool "GT917S per MediaTek package"
	default n
	help
	  Say Y here if you have GT5688 touch panel GTP_ESD_PROTECT.

	  If unsure, say N.

	  To compile this dirver as a module, choose M here: the
	  module will be called.

config GTP_CHARGER_SWITCH
	bool "GT917S per MediaTek package"
	default n
	help
	  Say Y here if you have GT5688 touch panel GTP_CHARGER_SWITCH.

	  If unsure, say N.

	  To compile this dirver as a module, choose M here: the
	  module will be called.

config GTP_DEBUG_ARRAY_ON
	bool "GT917S per MediaTek package"
	default n
	help
	  Say Y here if you have GT5688 touch panel GTP_DEBUG_ARRAY_ON.

	  If unsure, say N.

	  To compile this dirver as a module, choose M here: the
	  module will be called.

config GTP_DEBUG_FUNC_ON
	bool "GT917S per MediaTek package"
	default n
	help
	  Say Y here if you have GT5688 touch panel GTP_DEBUG_FUNC_ON.

	  If unsure, say N.

	  To compile this dirver as a module, choose M here: the
	  module will be called.

config GTP_POWER_CTRL_SLEEP
	bool "GT917S per MediaTek package"
	default n
	help
	  Say Y here if you have GT5688 touch panel GTP_POWER_CTRL_SLEEP.

	  If unsure, say N.

	  To compile this dirver as a module, choose M here: the
	  module will be called.

config GTP_ICS_SLOT_REPORT
	bool "GT5688 for TYPE_B_PROTOCOL"
	default n
	help
	  Say Y here if you have GT5688 touch panel GTP_ICS_SLOT_REPORT
	  to support TYPE_B_PROTOCOL.

	  If unsure, say N.

	  To compile this dirver as a module, choose M here: the
	  module will be called.
endif
```

## drivers/input/touchscreen/mediatek/ft8719/Kconfig
```kconfig
config WTK_FT8719_E977
	bool "FocalTech FT8719 touch for the MediaTek package (Doogee S88 Pro, from the disassembly)"
	default n
	help
	  FocalTech FT8719 touchscreen of the Doogee S88 Pro, reconstructed by
	  reading the disassembled factory kernel.  The factory config turns it
	  on (CONFIG_WTK_FT8719_E977=y in e977_dg_m13_71_q0.config) and the ALPS
	  tree does not have the symbol: without this entry `olddefconfig`
	  discards the factory config line in silence.

	  THE BATCH IS COMPLETE since 2026-08-22: the factory block has 67
	  functions in SIX translation units, and all 67 are here.

	    focaltech_core.c            unit C  16 fn
	    focaltech_sysfs.c           unit A  22 fn
	    focaltech_flash.c           unit B  17 fn
	    focaltech_ex_mode.c         unit D   3 fn
	    focaltech_i2c.c             unit E   7 fn
	    focaltech_ft8719_upgrade.c  unit F   3 fn (plus the upgrade)

	  64 of the 67 match to the byte with the factory compiler
	  (clang-r353983c).  The three that do not are in focaltech_core.c:
	  tpd_probe, get_module_id and touch_event_handler.

	  THIS TEXT USED TO SAY "THE DRIVER DOES NOT LINK" and listed unit B as
	  missing in full: that was true when it was written and is not any more.
	  The name `focaltech_flash.c` is a declared CHOICE -- FocalTech does not
	  use `pr_debug`, so there are no `_ddebug` descriptors naming its files
	  and the binary does not give the name.
```

## drivers/input/touchscreen/mediatek/ilitek_e977/Kconfig
```kconfig
config WTK_ILITEK_E977
	bool "ILITEK touch for the MediaTek package (Doogee S88 Pro, from the disassembly)"
	default n
	help
	  ILITEK touchscreen of the Doogee S88 Pro, reconstructed by reading the
	  disassembled factory kernel.  The factory config turns it on
	  (CONFIG_WTK_ILITEK_E977=y) and the ALPS tree does not have the symbol:
	  without this entry `olddefconfig` discards the factory config line in
	  silence.

	  The factory block has 153 functions in eight translation units.

	  THERE IS NO CONSTRAINT WITH THE OTHER TWO TOUCHSCREENS, and an earlier
	  draft of this Kconfig had a wrong one.  It said the three exclude each
	  other, and chained them with `depends on`; the factory config turns ALL
	  THREE on:

	    2220:CONFIG_WTK_GT917S_E977=y
	    2224:CONFIG_WTK_ILITEK_E977=y
	    2227:CONFIG_WTK_FT8719_E977=y

	  And it makes sense: MediaTek's `tpd` framework registers several drivers
	  and chooses at run time which panel answers.  This driver's `tpd_probe`,
	  `tpd_suspend`, `tpd_resume` and `tpd_local_init` are `static`, so they do
	  not collide with those of FT8719 and GT917S -- the three do not even have
	  one global symbol in common, and it is measured:

	    $ comm -12 <(nm --defined-only --extern-only GT917S/built-in.o) \
	                <(nm --defined-only --extern-only ilitek_e977/built-in.o)
	    (no lines)

	  But all three register a `tpd_driver_t` for the same panel, and only one
	  is to be turned on.
```
